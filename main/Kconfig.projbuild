## main/Kconfig.projbuild
```kconfig
menu "Wisp Configuration"

    config WISP_WIFI_SSID
        string "WiFi SSID"
        default "your_ssid"
        help
            WiFi network name to connect to.

    config WISP_WIFI_PASSWORD
        string "WiFi Password"
        default "your_password"
        help
            WiFi network password.

endmenu
```

## sdkconfig.defaults
```kconfig
# Partition Table
CONFIG_PARTITION_TABLE_CUSTOM=y
CONFIG_PARTITION_TABLE_CUSTOM_FILENAME="partitions.csv"

# Flash
CONFIG_ESPTOOLPY_FLASHSIZE_8MB=y
CONFIG_ESPTOOLPY_FLASHMODE_QIO=y

# WiFi - optimize for relay workload
CONFIG_ESP_WIFI_STATIC_RX_BUFFER_NUM=6
CONFIG_ESP_WIFI_DYNAMIC_RX_BUFFER_NUM=16
CONFIG_ESP_WIFI_RX_BA_WIN=8

# HTTP Server with WebSocket
CONFIG_HTTPD_WS_SUPPORT=y
CONFIG_HTTPD_MAX_REQ_HDR_LEN=1024
CONFIG_HTTPD_MAX_URI_LEN=512

# lwIP - optimize for relay workload
CONFIG_LWIP_MAX_SOCKETS=48
CONFIG_LWIP_SO_REUSE=y
CONFIG_LWIP_SO_LINGER=y
CONFIG_LWIP_TCP_MSS=1436
CONFIG_LWIP_TCP_SND_BUF_DEFAULT=11456
CONFIG_LWIP_TCP_WND_DEFAULT=11456

# FreeRTOS
CONFIG_FREERTOS_HZ=1000
CONFIG_ESP_MAIN_TASK_STACK_SIZE=16384

# Compiler
CONFIG_COMPILER_OPTIMIZATION_PERF=y
CONFIG_COMPILER_DISABLE_GCC12_WARNINGS=y

# PSRAM (if using N8R8 or N16R8 module)
CONFIG_ESP32S3_SPIRAM_SUPPORT=y
CONFIG_SPIRAM_MODE_OCT=y
CONFIG_SPIRAM_SPEED_80M=y
CONFIG_SPIRAM_IGNORE_NOTFOUND=y

# Console
CONFIG_ESP_CONSOLE_UART_DEFAULT=y
CONFIG_ESP_CONSOLE_UART_BAUDRATE=115200

# Logging
CONFIG_BOOTLOADER_LOG_LEVEL_WARN=y
CONFIG_LOG_DEFAULT_LEVEL_INFO=y
```
